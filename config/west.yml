## config/west.yml
```yaml
manifest:
  remotes:
  - name: zmkfirmware
    url-base: https://github.com/zmkfirmware
  - name: urob
    url-base: https://github.com/urob
  - name: car-kaboomer
    url-base: https://github.com/car-kaboomer
  projects:
  - name: zmk
    remote: zmkfirmware
    revision: v0.3
    import: app/west.yml
  - name: zmk-helpers
    remote: urob
    revision: v0.3
  - name: zmk-keyboard-metasepia
    remote: car-kaboomer
    revision: main
  - name: zmk-keyboard-ravine
    remote: car-kaboomer
    revision: main
  - name: zmk-keyboard-metasepia2
    remote: car-kaboomer
    revision: main
  self:
    path: config
```
