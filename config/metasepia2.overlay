/ {
    chosen {
        zmk,kscan = &components_up_kscan;
        zmk,physical-layout = &pinky_attached_physical_layout;
    };

    /*encoder_left {
        steps = <80>;
        status = "okay";
    };
    encoder_right {
        steps = <80>;
        status = "okay";
    };
    sensors {
        triggers-per-rotation = <20>;
    };*/
};