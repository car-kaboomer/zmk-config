#include "layout_definition/ravine.dtsi"

&sensors {
     status = "okay";
     sensors = <&left_encoder &right_encoder>;
    triggers-per-rotation = <20>;
};

&left_encoder { status = "okay"; steps = <80>; }; // "disabled" or "okay"
&right_encoder { status = "disabled"; steps = <80>; };


#include "base_keymap.dtsi"